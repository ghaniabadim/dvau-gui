## package/dvau-gui/Config.in
```kconfig
config BR2_PACKAGE_DVAU_GUI
	bool "DVAU control panel"
	depends on BR2_PACKAGE_LVGL
	help
	  Full-screen LVGL control-panel application for a 480x272 Linux
	  framebuffer display. It starts on /dev/fb0 by default.
```

## package/lvgl/Config.in
```kconfig
config BR2_PACKAGE_LVGL
	bool "lvgl"
	depends on BR2_USE_MMU
	help
	  LVGL is a lightweight, portable graphics library for embedded Linux.
```
